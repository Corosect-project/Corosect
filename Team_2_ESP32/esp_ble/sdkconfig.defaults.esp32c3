## Team_2_ESP32/esp_ble/sdkconfig.defaults.esp32c3
```kconfig
CONFIG_BT_ENABLED=y
CONFIG_BT_GATTS_PPCP_CHAR_GAP=y
CONFIG_BT_BLE_BLUFI_ENABLE=y
CONFIG_BT_BLE_42_FEATURES_SUPPORTED=y
```

## Team_2_ESP32/no-arduino/main/Kconfig.projbuild
```kconfig
menu "Corosect project configuration"

    menu "I2C configuration"
        config I2C_MASTER_SDA
            int "SDA GPIO num"
            default 6
            help 
                I2C data line pin.

        config I2C_MASTER_SCL
            int "SCL GPIO num"
            default 7
            help 
                I2C clock line pin.

        config I2C_MASTER_FREQ
            int "Master clock frequency (Hz)"
            default 100000
            help
                I2C Master clock frequency. Maximum for RTC is 1MHz.

        config I2C_CO2_ADDR
            hex "I2C address for STC31 CO2 sensor"
            default 0x29
            help
                I2C address for STC31 CO2 sensor. By default 0x29 (41).
    endmenu

    menu "WiFi configuration"
        config WIFI_SSID
            string "WiFi SSID"
            default ""
            help
                SSID for the network to connect to.

        config WIFI_PASSWORD
            string "WiFi password"
            default ""
            help
                Password for the network. 
                Leave blank if not required.

        config WIFI_RETRY_MAX
            int "Retry attempts"
            default 5
            help
                Number of times a connection to the specified AP is attempted.

        choice WIFI_SCAN_METHOD
            prompt "Scan method"
            default WIFI_FAST_SCAN
            help
                WiFi scan method.

            config WIFI_FAST_SCAN
                bool "fast"
                help
                    stop scan as soon as network is found

            config WIFI_ALL_CHANNEL_SCAN
                bool "all"
                help
                    keep scanning whole channel
        endchoice
    endmenu

    menu "MQTT configuration"
        config MQTT_BROKER
            string "MQTT Broker URI"
            default ""
            help
                URI for the MQTT broker to connect to.
                Note: needs to be in the form of mqtt://broker.address.here:port

        config MQTT_TIMEOUT
            int "MQTT timeout (ms)"
            default "5000"
            help
                Timeout for MQTT connection.

        config MQTT_MAX_RETRY
            int "MQTT Maximum retry"
            default "3"
            help
                Maximum number of retries for mqtt connection.
    endmenu

    config SAMPLES
        int "Samples"
        default 5
        help
            Number of measurements taken every cycle.
    config MEASURE_INTERVAL
        int "Measurement interval (ms)"
        default 1000
        help
            Time between each measurement. 
            Should be >= 1000.

    config SLEEP_MS
        int "Sleep time (ms)"
        default 5000
        help
            Time to sleep between each cycle.
    config ERR_SLEEP_MS
        int "Sleep time in case of failure (ms)"
        default 5000
        help
            Time to sleep in case of a failure during WiFi or MQTT connection.

    config SENSOR_POWER_GPIO
        int "CO2 sensor power GPIO num"
        default 3
        help
            GPIO for CO2 sensor power.

    config LED_GPIO
        int "LED GPIO num (WORK IN PROGRESS)"
        default 8
        help
            GPIO that an indicator LED is attached to.


endmenu
```
