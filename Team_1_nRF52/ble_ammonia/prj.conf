## CMakeLists.txt
```
# SPDX-License-Identifier: Apache-2.0

cmake_minimum_required(VERSION 3.20.0)

find_package(Zephyr REQUIRED HINTS $ENV{ZEPHYR_BASE})
project(corosect-project)

target_sources(app PRIVATE src/main.c)
target_sources_ifndef(CONFIG_DISABLE_NH3 app PRIVATE src/nh3_sensor.c)
target_sources(app PRIVATE src/bluetooth.c)
target_sources(app PRIVATE src/temp.c)
target_sources(app PRIVATE src/power.c)
```

## Kconfig
```
source "Kconfig.zephyr"

config DISABLE_NH3
  bool 'Disable nh3 spi code'
  default n
```

## prj.conf
```kconfig
# nRF SDKs
CONFIG_DK_LIBRARY=y
CONFIG_NRFX_TEMP=y

# Enable Bluetooth Low Energy
CONFIG_BT=y
CONFIG_BT_PERIPHERAL=y
CONFIG_BT_HCI=y
CONFIG_BT_CTLR=y
CONFIG_BT_BROADCASTER=y

# Real time clock (zephyr counter library)
CONFIG_COUNTER=y
CONFIG_COUNTER_RTC2=y

## Configs for enabling/disabling nh3 sensor code
# Enable/Disable nh3, requires spi from below
CONFIG_DISABLE_NH3=y

# Enable SPIM (SPI with EasyDMA)
# CONFIG_SPI=y
# CONFIG_SPI_NRFX=y
# CONFIG_NRFX_SPIM0=y

# CONFIG_SOC_NRF52832_ALLOW_SPIM_DESPITE_PAN_58=y
```

## debug.conf
```kconfig
# Enable Zephyr Log API
CONFIG_LOG=y
CONFIG_LOG_PRINTK=n
CONFIG_BT_LOG_LEVEL_DBG=y
CONFIG_COUNTER_LOG_LEVEL_DBG=y

# Don't reset on hard fault and display thread names
CONFIG_THREAD_NAME=y
CONFIG_RESET_ON_FATAL_ERROR=n
```

## optimize.conf
```kconfig
CONFIG_SERIAL=n
CONFIG_CONSOLE=n
CONFIG_UART_CONSOLE=n
```

## nrf52dk_nrf52832.overlay
```dts
// To get started, press Ctrl+Space to bring up the completion menu and view the available nodes.

// You can also use the buttons in the sidebar to perform actions on nodes.
// Actions currently available include:

// * Enabling / disabling the node
// * Adding the bus to a bus
// * Removing the node
// * Connecting ADC channels

// For more help, browse the DeviceTree documentation at https://docs.zephyrproject.org/latest/guides/dts/index.html
// You can also visit the nRF DeviceTree extension documentation at https://nrfconnect.github.io/vscode-nrf-connect/devicetree/nrfdevicetree.html

&spi0 {
	status = "okay";
  compatible = "nordic,nrf-spim";
};

&rtc2 {
  wakeup-source;
};
```

## src/main.c
```c
/*
 * Copyright (c) 2023 OAMK Corosect-project.
 *
 * SPDX-License-Identifier: MIT
 */

#include <dk_buttons_and_leds.h>
#include <zephyr/kernel.h>
#include <zephyr/logging/log.h>
#include <zephyr/pm/pm.h>

#include "bluetooth.h"
#include "power.h"
#include "temp.h"

#ifndef CONFIG_DISABLE_NH3
#include "nh3_sensor.h"
#endif

LOG_MODULE_REGISTER(app, LOG_LEVEL_DBG);

#define ERROR(err) (err < 0)

void button_handler(uint32_t state, uint32_t has_changed);

volatile bool quit = false;
static struct k_sem sleep_sem;

void main(void) {
  LOG_INF("Hello World! %s", CONFIG_BOARD);

  // init(&sleep_sem);

  if (ERROR(dk_buttons_init(button_handler)))
    LOG_ERR("Error initializing buttons");

    // init_temp();
    // start_bt();

#ifndef CONFIG_DISABLE_NH3
  init_nh3();
#endif
  start_bt();

  while (!quit) {
#ifndef CONFIG_DISABLE_NH3
    read_and_print_nh3();
#endif

    // Initialize
    init_temp();
    start_bt();

    // Read temp and wait for 2 seconds for bt;
    int32_t temp = read_temp();
    set_temp(temp);
    send_data();

    // Got to sleep
    uninit_temp();
    stop_bt();
    k_sleep(K_SECONDS(10));
  }

  LOG_INF("QUIT\n");
  stop_bt();
}

void button_handler(uint32_t state, uint32_t has_changed) {
  if (DK_BTN2_MSK == has_changed) {
    quit = true;
    k_sem_give(&sleep_sem);
  }
}
```

## src/bluetooth.c
```c
/**
 * @brief File for controling bluetooth GATT services
 * and managing the bluetoot state
 *
 * @copyright Copyright (c) 2023 OAMK Corosect-project
 *
 */
#include "bluetooth.h"

#include <zephyr/bluetooth/bluetooth.h>
#include <zephyr/bluetooth/conn.h>
#include <zephyr/bluetooth/gatt.h>
#include <zephyr/bluetooth/uuid.h>
#include <zephyr/logging/log.h>
#include <zephyr/sys/byteorder.h>

LOG_MODULE_DECLARE(app, LOG_LEVEL_DBG);

#define ERROR(err) (err < 0)

ssize_t read_gatt(
    struct bt_conn *conn,
    const struct bt_gatt_attr *attr,
    void *buf,
    uint16_t len,
    uint16_t offset
);

static int32_t temp = 0.0f;

BT_GATT_SERVICE_DEFINE(
    sensor_service,
    BT_GATT_PRIMARY_SERVICE(BT_UUID_ESS),
    BT_GATT_CHARACTERISTIC(
        BT_UUID_TEMPERATURE,
        BT_GATT_CHRC_READ | BT_GATT_CHRC_BROADCAST,
        BT_GATT_PERM_READ,
        read_gatt,
        NULL,
        &temp
    ),
    BT_GATT_CHARACTERISTIC(
        CUSTOM_UUID,
        BT_GATT_CHRC_READ,
        BT_GATT_PERM_READ,
        read_gatt,
        NULL,
        "Hello, world"
    ),
);

int start_bt() {
  int err = bt_enable(NULL);
  if (ERROR(err)) {
    LOG_ERR("Error enabling BT %d", errno);
    return err;
  }

  return 0;
}

void stop_bt() {
  // bt_le_adv_stop();
  bt_disable();
}

void set_temp(int32_t newTemp) {
  temp = newTemp;
  struct bt_gatt_attr *attr =
      bt_gatt_find_by_uuid(&sensor_service.attrs[0], 0, BT_UUID_TEMPERATURE);
  LOG_DBG("%p: %d", (void *)attr, *(int *)attr->user_data);
}

// clang-format off
#define INT_TO_LE_BYTE_ARRAY(val32) { \
      val32 & 0x000000ff,             \
      (val32 >> 8) & 0x000000ff,      \
      (val32 >> 16) & 0x000000ff,     \
      (val32 >> 24) & 0x000000ff,     \
  }
// clang-format on
#define SPREAD_BYTE_4(data) data[0], data[1], data[2], data[3]

void send_data() {
  struct bt_gatt_attr *attr =
      bt_gatt_find_by_uuid(&sensor_service.attrs[0], 0, BT_UUID_TEMPERATURE);
  if (!attr) {
    LOG_ERR("Error getting gatt attribute");
    return;
  }

  const void *data = attr->user_data;
  const uint32_t value = *(uint32_t *)data;
  const uint8_t fdata[] = INT_TO_LE_BYTE_ARRAY(value);

  LOG_DBG("Data: %x", value);
  LOG_DBG("%x %x %x %x", SPREAD_BYTE_4(fdata));

  struct bt_data ad[] = {
      BT_DATA_BYTES(BT_DATA_FLAGS, (BT_LE_AD_NO_BREDR)),
      BT_DATA_BYTES(
          BT_DATA_SVC_DATA16,
          BT_UUID_16_ENCODE(BT_UUID_ESS_VAL),
          SPREAD_BYTE_4(fdata)
      ),
  };
  LOG_DBG("%p: %d", (void *)attr, *(uint32_t *)data);

  int err = bt_le_adv_start(BT_LE_ADV_NCONN_NAME, ad, ARRAY_SIZE(ad), 0, 0);
  if (err == -ENOMEM) LOG_ERR("ENOMEM\n");
  else if (err == -ECONNREFUSED || err == -EIO) LOG_ERR("ECONNREFUSED\n");

  LOG_DBG("Error %d\n", err);
  k_sleep(K_SECONDS(1));
  bt_le_adv_stop();
}

ssize_t read_gatt(
    struct bt_conn *conn,
    const struct bt_gatt_attr *attr,
    void *buf,
    uint16_t len,
    uint16_t offset
) {
  void *value = attr->user_data;
  return bt_gatt_attr_read(conn, attr, buf, len, offset, value, strlen(value));
}
```

## src/bluetooth.h
```c
#ifndef D03F4BBC_6443_4B62_AD6C_C08762252757
#define D03F4BBC_6443_4B62_AD6C_C08762252757

#include <zephyr/kernel.h>

// clang-format off
#define CUSTOM_UUID_VAL BT_UUID_128_ENCODE(0xd8b807ec, 0xef6e, 0x11ed, 0xa05b, 0x0242ac120003)  // d8b807ec-ef6e-11ed-a05b-0242ac120003
#define CUSTOM_UUID BT_UUID_DECLARE_128(CUSTOM_UUID_VAL)
// clang-format on

int start_bt();
void stop_bt();
void set_temp(int32_t temp);
void send_data();

#endif /* D03F4BBC_6443_4B62_AD6C_C08762252757 */
```

## src/config.c
```c
#include "config.h"

#include <zephyr/logging/log.h>
#include <zephyr/net/net_config.h>
#include <zephyr/net/net_if.h>

LOG_MODULE_DECLARE(app, LOG_LEVEL_DBG);

static struct in6_addr my_addr;

/**
 * @brief Initialize network interface for later use
 * 
 * @param ip this device's ip address
 */
void init_network(char* ip) {
  int err;

  struct net_if* iface = net_if_get_default();
  if (!iface) {
    LOG_ERR("Didn't get interface");
    return;
  }

  if (!net_if_is_admin_up(iface)) {
    LOG_ERR("IFACE is not admin up");
  }

  // Check if interface is up and set it up otherwise
  if (!net_if_is_up(iface)) {
    LOG_DBG("Setting iface up");
    err = net_if_up(iface);
    if (err < 0) LOG_ERR("Error setting iface to up, %d", err);
  }

  err = net_addr_pton(AF_INET6, ip, &my_addr); // Convert the string to byte format and copy the address to in6_addr struct
  if (err < 0) LOG_ERR("Error on coppying ip, %d", err);
  struct net_if_addr* iface_addr = net_if_ipv6_addr_add(iface, &my_addr, NET_ADDR_MANUAL, 0); // Add the address to the interface
  if (!iface_addr) LOG_ERR("Couldn't set ip");

  if (net_if_is_admin_up(iface) && net_if_is_carrier_ok(iface) && !net_if_is_dormant(iface)) {
    LOG_DBG("IF STATUS: OPER UP");
  }

  LOG_DBG("Start net_config");
  err = net_config_init_by_iface(iface, "Zephyr MQTT", NET_CONFIG_NEED_IPV6, 30000); // Initialize rest of the network stack
  if (err < 0) LOG_ERR("Initialization error, %d", err);
  LOG_DBG("Network setup done");
}
```

## src/config.h
```c
#ifndef BF497F20_BB34_484E_BD6B_05FB88F2766D
#define BF497F20_BB34_484E_BD6B_05FB88F2766D

void init_network(char* ip);

#endif /* BF497F20_BB34_484E_BD6B_05FB88F2766D */
```

## src/mqtt.c
```c
#include "mqtt.h"

#include <zephyr/logging/log.h>
LOG_MODULE_DECLARE(app, LOG_LEVEL_DBG);

// MQTT global variables
struct zsock_pollfd fds[1] = {0};
bool connected = false;

// MQTT
static uint8_t rx_buffer[256];
static uint8_t tx_buffer[256];
static struct mqtt_client client_ctx;
static struct sockaddr_storage broker;

void mqtt_evt_handler(struct mqtt_client *client, const struct mqtt_evt *evt);

/**
 * @brief Initialize mqtt parameters and set broker ip and port
 * 
 * @param server_ip broker's ip address
 * @param port broker's port
 * @return Pointer to the client struct or NULL on failure
 */
struct mqtt_client *init_mqtt(const char *server_ip, uint32_t port) {
  uint32_t err;

  uint8_t *client_id = "ZEPHYR";
  mqtt_client_init(&client_ctx);
  client_ctx.broker = &broker;
  client_ctx.evt_cb = mqtt_evt_handler;
  client_ctx.client_id.utf8 = client_id;
  client_ctx.client_id.size = sizeof(client_id) - 1;
  client_ctx.password = NULL; // No password
  client_ctx.user_name = NULL; // No username
  client_ctx.protocol_version = MQTT_VERSION_3_1_1;
  client_ctx.transport.type = MQTT_TRANSPORT_NON_SECURE; // No TLS certificates

  client_ctx.rx_buf = rx_buffer;
  client_ctx.rx_buf_size = sizeof(rx_buffer);
  client_ctx.tx_buf = tx_buffer;
  client_ctx.tx_buf_size = sizeof(tx_buffer);

  struct sockaddr_in6 *broker6 = (struct sockaddr_in6 *)&broker;
  memset(broker6, 0, sizeof(*broker6)); // Zero the struct

  broker6->sin6_family = AF_INET6;
  broker6->sin6_port = htons(port);
  err = net_addr_pton(AF_INET6, server_ip, &broker6->sin6_addr); // Assign broker's ip address to sockaddr struct
  LOG_DBG("TEST: %d", err);
  // zsock_inet_pton(AF_INET6, SERVER_ADDR, &broker6->sin6_addr);

  // Set pollable events for later use
  fds[0].fd = client_ctx.transport.tcp.sock;
  fds[0].events = ZSOCK_POLLIN;

  if (err == 0)
    return &client_ctx;
  else
    return NULL;
}

/**
 * @brief Publish message to specific topic
 * 
 * @param msg message string
 * @param topic MQTT topic
 * @return 0 or negative error code (Zephyr errno.h)
 */
int send_message(char *msg, char *topic) {
  struct mqtt_publish_param param = {0};
  param.message.payload.data = msg;
  param.message.payload.len = strlen(msg);
  param.message.topic.qos = MQTT_QOS_0_AT_MOST_ONCE;
  param.message.topic.topic.utf8 = topic;
  param.message.topic.topic.size = strlen(topic);
  return mqtt_publish(&client_ctx, &param);
}

void mqtt_evt_handler(struct mqtt_client *client, const struct mqtt_evt *evt) {
  LOG_ERR("MQTT_CALLBACK");
  switch (evt->type) {
    case MQTT_EVT_CONNACK:
      if (evt->result != 0) {
        LOG_ERR("Error connecting: %d", evt->result);
        break;
      }
      LOG_INF("MQTT connected");
      connected = true;
      break;
    case MQTT_EVT_DISCONNECT:
      LOG_INF("MQTT disconnected");
      connected = false;
      break;
    case MQTT_EVT_PINGRESP:
      LOG_INF("Ping response");
      break;
    default:
      LOG_INF("MQTT default");
      break;
  }
}
```

## src/mqtt.h
```c
#ifndef D2AE867A_AFDC_452A_AB8B_77B11E1601C5
#define D2AE867A_AFDC_452A_AB8B_77B11E1601C5

#include <zephyr/kernel.h>
#include <zephyr/net/mqtt.h>
#include <zephyr/net/socket.h>

extern bool connected;
extern struct zsock_pollfd fds[1];

struct mqtt_client* init_mqtt(const char* ip, uint32_t port);
int send_message(char* msg, char* topic);

#endif /* D2AE867A_AFDC_452A_AB8B_77B11E1601C5 */
```

## src/nh3_sensor.c
```c
/*
 * Copyright (c) 2023 OAMK Corosect-project.
 *
 * SPDX-License-Identifier: MIT
 */
#include "nh3_sensor.h"

#include <nrfx_spim.h>
#include <zephyr/kernel.h>
#include <zephyr/logging/log.h>

LOG_MODULE_DECLARE(app, LOG_LEVEL_DBG);

static nrfx_spim_t instance = NRFX_SPIM_INSTANCE(0);
static nrfx_spim_config_t config = NRFX_SPIM_DEFAULT_CONFIG(
    SCK_PIN, NRFX_SPIM_PIN_NOT_USED, SDO_PIN, NRFX_SPIM_PIN_NOT_USED
);

static uint8_t rx_buff[3];
static struct nh3_spi_data data;
static nrfx_spim_xfer_desc_t transf = NRFX_SPIM_XFER_RX(rx_buff, 3);

static inline void set_cs() {
  nrf_gpio_pin_set(CS_PIN);
  k_sleep(K_NSEC(100));
}

static inline void clear_cs() {
  nrf_gpio_pin_clear(CS_PIN);
  k_sleep(K_NSEC(100));
}

void init_nh3() {
  config.mode = NRF_SPIM_MODE_3;
  nrf_gpio_cfg_output(CS_PIN);
  set_cs();
  if (nrfx_spim_init(&instance, &config, NULL, NULL) != NRFX_SUCCESS)
    LOG_ERR("Could't enable spi\n");
}

// First reads the data and if raed is successful
// foramat the data using helper functions for printing
void read_and_print_nh3() {
  int err = read_nh3_data();
  printk("ERROR_CODE: %d\n", err);
  if (err == NRFX_SUCCESS) {
    print_spi_data(rx_buff, sizeof(rx_buff));
    format_nh3_data(rx_buff, sizeof(rx_buff), &data);
    print_nh3_struct(&data);
  }
}

// To read the nh3 data the function first starts the conversion process
// and waits for it to complete after which it reads the data
int read_nh3_data() {
  uint32_t ready = 1;
  do {
    clear_cs();
    ready = nrf_gpio_pin_read(SDO_PIN);
    if (ready != 0) {
      set_cs();
      k_sleep(K_MSEC(10));
    }
    printk("0x%x\n", ready);
  } while (ready != 0);

  int err = nrfx_spim_xfer(&instance, &transf, 0);
  set_cs();
  return err;
}

void print_spi_data(uint8_t *spi_data, size_t size) {
  printk("DATA:");
  for (size_t i = 0; i < size; i++) printk(" %x", spi_data[i]);
  printk("\n");
}

// Formats `spi_data` which is uint8_t array in MSB, that contains atleas three
// elements. All elements above three are not accounted.
void format_nh3_data(
    uint8_t *spi_data, size_t size, struct nh3_spi_data *_out_data
) {
  if (size < 3) return;
  _out_data->OL = spi_data[0] >> 7;  // Get the MSB which indicates overflow low
  _out_data->OH = (spi_data[0] >> 6) & 0x01;  // Get the overflow high bit
  _out_data->value = spi_data[2] | spi_data[1] << 8 |     // Get the value bits
                     (spi_data[0] & 0x1f) << 16;          // from the data
  _out_data->value |= ((spi_data[0] & 0x20) << 2) << 24;  // Get the sign bit
}

void print_nh3_struct(struct nh3_spi_data *data) {
  printk("OL: %d OH: %d VALUE: %d", data->OL, data->OH, data->value);
}
```

## src/nh3_sensor.h
```c
/**
 * @file nh3_sensor.h
 * @brief Internal logic for communicating with ammonia
 * click nh3 sensor using spi
 *
 * @copyright Copyright (c) 2023 OAMK Corosect-project.
 *
 */
#ifndef BE821905_0997_4832_BD03_42B95D20393B
#define BE821905_0997_4832_BD03_42B95D20393B

#include <stdbool.h>
#include <stddef.h>
#include <stdint.h>

#define CS_PIN 27
#define SCK_PIN 26
#define SDO_PIN 2

/**
 * @brief Data structure to hold nh3 spi data in a easy to use format.
 */
struct nh3_spi_data {
  bool OL;
  bool OH;
  uint32_t value;
};

/**
 * @brief Initializes spi and sets the required configs
 * for communicating with the nh3 sensor.
 */
void init_nh3();

/**
 * @brief Performs an read on the sensor and prints the result to serail.
 *
 */
void read_and_print_nh3();

/**
 * @brief Tries to read nh3 data from the spi
 *
 * @return 0 on success and a negative error code on error
 */
int read_nh3_data();

/**
 * @brief Helper to print the spi data array.
 *
 * @param spi_data byte array
 * @param size size of the array
 */
void print_spi_data(uint8_t *spi_data, size_t size);

/**
 * @brief Formats an byte array to `struct nh3_spi_data` format.
 * Requires at least three bytes and all byte after three are ignored.
 *
 * @param spi_data byte array
 * @param size size of the array
 * @param _out_data pointer to the output variable
 *
 * @return nh3 data in `_out_data` pointer
 *
 */
void format_nh3_data(
    uint8_t *spi_data, size_t size, struct nh3_spi_data *_out_data
);

/**
 * @brief Prints `nh3_spi_data` struct to serial
 *
 * @param data pointer to the data struct to print
 */
void print_nh3_struct(struct nh3_spi_data *data);

#endif /* BE821905_0997_4832_BD03_42B95D20393B */
```

## src/power.c
```c
#include <zephyr/device.h>
#include <zephyr/devicetree.h>
#include <zephyr/drivers/counter.h>
#include <zephyr/kernel.h>
#include <zephyr/logging/log.h>

LOG_MODULE_DECLARE(app, LOG_LEVEL_DBG);

#define ALARM_CHAN_ID 0
#define RTC DT_NODELABEL(rtc2)

static struct counter_alarm_cfg config;

static void alarm_cb(
    const struct device *dev, uint8_t chan_id, uint32_t ticks, void *user_data
) {
  int32_t now_ticks;
  int err = counter_get_value(dev, &now_ticks);
  if (err < 0) LOG_ERR("Error reading value");

  uint64_t now_usec = counter_ticks_to_us(dev, now_ticks);
  int now_sec = now_usec / USEC_PER_SEC;

  LOG_INF("!!! ALARM !!!");
  LOG_INF("Time  %u (%u ticks)", now_sec, now_ticks);

  struct k_sem *sem = user_data;
  k_sem_give(sem);
}

void init(struct k_sem *sleep_sem) {
  k_sem_init(sleep_sem, 1, 1);
  const struct device *rtc = DEVICE_DT_GET(RTC);
  if (!device_is_ready(rtc)) {
    LOG_ERR("Rtc not available");
    rtc = NULL;
    return;
  }

  int err = counter_start(rtc);
  if (err < 0) {
    LOG_ERR("Error: %d", -err);
    rtc = NULL;
    return;
  }

  LOG_DBG("Rtc started");

  config.flags = 0;
  config.ticks = counter_us_to_ticks(rtc, 30 * USEC_PER_SEC);
  config.callback = alarm_cb;
  config.user_data = sleep_sem;
}

void wait_for_rtc(struct k_sem *sleep_sem) {
  const struct device *rtc = DEVICE_DT_GET(RTC);
  if (config.user_data != sleep_sem) return;
  int err = counter_set_channel_alarm(rtc, ALARM_CHAN_ID, &config);
  if (err == -EBUSY) {
    LOG_WRN("EBUSY");
  } else if (err < 0) {
    LOG_ERR("Error while setting alarm: %d", -err);
    return;
  }
  k_sem_take(sleep_sem, K_FOREVER);
}
```

## src/power.h
```c
#ifndef BFD61C63_F38B_4026_BC7B_953DAE8DE655
#define BFD61C63_F38B_4026_BC7B_953DAE8DE655

#include <zephyr/kernel.h>

void init(struct k_sem *sleep_sem);

void wait_for_rtc(struct k_sem *sleep_sem);

#endif /* BFD61C63_F38B_4026_BC7B_953DAE8DE655 */
```

## src/temp.c
```c
#include "temp.h"

#include <nrfx_temp.h>

static nrfx_temp_config_t config = NRFX_TEMP_DEFAULT_CONFIG;

void init_temp() { nrfx_temp_init(&config, NULL); }

void uninit_temp() { nrfx_temp_uninit(); }

int32_t read_temp() {
  int res = nrfx_temp_measure();
  int32_t raw_temp = 0;
  if (res == NRFX_SUCCESS) raw_temp = nrfx_temp_result_get();

  return nrfx_temp_calculate(raw_temp);
}
```

## src/temp.h
```c
#ifndef DEA60769_DB89_4940_8F0B_025CD3CB5DAE
#define DEA60769_DB89_4940_8F0B_025CD3CB5DAE

#include <zephyr/kernel.h>

void init_temp();
void uninit_temp();
int32_t read_temp();

#endif /* DEA60769_DB89_4940_8F0B_025CD3CB5DAE */
```
